## drivers/gpu/drm/panfrost/Kconfig
```kconfig
# SPDX-License-Identifier: GPL-2.0

config DRM_PANFROST
        tristate "Panfrost (DRM support for ARM Mali Midgard/Bifrost GPUs)"
        depends on DRM
        depends on ARM || ARM64 || (COMPILE_TEST && !GENERIC_ATOMIC64)
        depends on MMU
        select IOMMU_SUPPORT
        help
          DRM driver for ARM Mali Midgard (T6xx, T7xx, T8xx) and
          Bifrost (G3x, G5x, G7x) GPUs.
```
